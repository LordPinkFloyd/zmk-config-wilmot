## config/boards/shields/wilmot/Kconfig.defconfig
```kconfig
if SHIELD_WILMOT_LEFT

# Name must be less than 16 characters long!
config ZMK_KEYBOARD_NAME
    default "Wilmot"

config ZMK_SPLIT_ROLE_CENTRAL
    default y

endif

if SHIELD_WILMOT_LEFT || SHIELD_WILMOT_RIGHT

config ZMK_SPLIT
    default y

endif
```

## config/west.yml
```yaml
manifest:
    remotes:
        - name: zmkfirmware
          url-base: https://github.com/zmkfirmware
        # Additional modules containing boards/shields/custom code can be listed here as well
        # See https://docs.zephyrproject.org/3.2.0/develop/west/manifest.html#projects
        #-----
        # support nice_oled and nice_epaper
        - name: LordPinkFloyd
          url-base: https://github.com/LordPinkFloyd
    projects:
        - name: zmk
          remote: zmkfirmware
          revision: main
          import: app/west.yml
        # support nice_oled and nice_epaper
        - name: zmk-nice-oled
          remote: LordPinkFloyd
          revision: deletrius
    self:
        path: config
```
